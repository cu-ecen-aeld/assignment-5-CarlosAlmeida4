## base_external/package/aesd_char/Config.in
```kconfig
config BR2_PACKAGE_AESD_CHAR
	bool "aesd_char"
	depends on BR2_LINUX_KERNEL
	help
	  Assignment 8
```

## base_external/package/ldd/Config.in
```kconfig
config BR2_PACKAGE_LDD
	bool "ldd"
	depends on BR2_LINUX_KERNEL
	help
	  Includes Linux device drivers examples for assignment 7
```
